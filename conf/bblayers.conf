## conf/bblayers.conf
```bitbake
# LAYER_CONF_VERSION is increased each time build/conf/bblayers.conf
# changes incompatibly
LCONF_VERSION = "7"
OEROOT := "${@os.path.abspath(os.path.dirname(d.getVar('FILE', True)))}/../.."

BBPATH = "${TOPDIR}"

BBFILES = ""

require bblayers-base.inc
require bblayers-bsp.inc

include bblayers-factory.inc

BBLAYERS = " \
  ${OEROOT}/layers/meta-lmp/meta-lmp-base \
  ${BASELAYERS} \
  ${BSPLAYERS} \
  ${OEROOT}/layers/openembedded-core/meta \
"
```

## conf/local.conf
```bitbake
# CONF_VERSION is increased each time build/conf/ changes incompatibly
CONF_VERSION = "2"

# Which files do we want to parse:
BBMASK = ""

# Don't generate the mirror tarball for SCM repos, the snapshot is enough
BB_GENERATE_MIRROR_TARBALLS = "0"

# Disable build time patch resolution. This would launch a devshell
# and wait for manual intervention. We disable it.
PATCHRESOLVE = "noop"

#
# Parallelism Options
#
# These two options control how much parallelism BitBake should use. The first
# option determines how many tasks bitbake should run in parallel:
# Default to setting automatically based on cpu count
BB_NUMBER_THREADS ?= "${@oe.utils.cpu_count()}"
#
# The second option controls how many processes make should run in parallel
# when running compile tasks:
# Default to setting automatically based on cpu count
PARALLEL_MAKE ?= "-j ${@oe.utils.cpu_count()}"

#
# Shared-state files from other locations
#
# Shared state files are prebuilt cache data objects which can
# used to accelerate build time. This variable can be used to configure the
# system to search other mirror locations for these objects before it builds
# the data itself.
#
# This can be a filesystem directory, or a remote url such as http or ftp.
# These would contain the sstate-cache results from previous builds (possibly
# from other machines). This variable works like fetcher MIRRORS/PREMIRRORS
# and points to the cache locations to check for the shared objects.
#SSTATE_MIRRORS ?= "\
#file://.* https://storage.googleapis.com/lmp-cache/sstate-cache/PATH \n \
#"

# enable PR service on build machine itself
# its good for a case when this is the only builder
# generating the feeds
#PRSERV_HOST = "localhost:0"

#
# Default kernel provider
#
# The default kernel provider in the Linux microPlatform is 'linux-lmp', but
# if you wish to use the kernel provided by the board BSP layer, or your own
# kernel, replace the line below with the recipe name used by the desired
# kernel provider.
PREFERRED_PROVIDER_virtual/kernel ?= "linux-lmp"

# By default LmP kernel is configured to load only signed modules.
# The default key provided should only be used for development purposes.
# To create a custom signing key, follow the instructions on kernel documentation.
MODSIGN_KEY_DIR ?= "${TOPDIR}/conf/keys"

#
# SPL / U-Boot proper signing support
#
# Supported key type: RSA 2048
UBOOT_SPL_SIGN_KEYNAME ?= "spldev"
#
# U-Boot / fitImage signing support
#
# Supported key type: RSA 2048
UBOOT_SIGN_KEYDIR ??= "${TOPDIR}/conf/keys"
UBOOT_SIGN_KEYNAME ?= "ubootdev"
#UBOOT_SIGN_ENABLE ?= "1"

#
# OP-TEE: Custom TA signing key
#
# By default OP-TEE uses a development tree available as part of the git
# repository, which should only be used for development purposes. To use a
# custom signing key just generate a custom RSA 2048 key (PEM format) and
# set via the OPTEE_TA_SIGN_KEY variable.
OPTEE_TA_SIGN_KEY ??= "${TOPDIR}/conf/keys/opteedev.key"

#
# UEFI Secure Boot
#
# Folder for UEFI keys and certificates
UEFI_SIGN_KEYDIR ??= "${TOPDIR}/conf/keys/uefi"
#UEFI_SIGN_ENABLE ?= "1"
```
